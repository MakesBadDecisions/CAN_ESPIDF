## CAN_Display/sdkconfig.defaults
```kconfig
# CAN_ESPIDF Display Node - SDK Configuration Defaults
# Target: ESP32-S3 (Elecrow CrowPanel 4.3", N4R2)

# --- CPU & Memory ---
CONFIG_ESP_DEFAULT_CPU_FREQ_MHZ_240=y
CONFIG_FREERTOS_HZ=1000
CONFIG_FREERTOS_UNICORE=n
CONFIG_ESP_SYSTEM_EVENT_TASK_STACK_SIZE=4096

# --- Flash & Partitions ---
CONFIG_ESPTOOLPY_FLASHSIZE_4MB=y
CONFIG_PARTITION_TABLE_CUSTOM=y
CONFIG_PARTITION_TABLE_CUSTOM_FILENAME="partitions.csv"

# --- PSRAM (Quad for N4R2) ---
CONFIG_SPIRAM=y
CONFIG_SPIRAM_MODE_QUAD=y

# --- SPI (for SD Card) ---
CONFIG_SPI_MASTER_IN_IRAM=y

# --- WiFi (AP for config + log download) ---
CONFIG_ESP_WIFI_ENABLED=y
CONFIG_ESP_WIFI_SOFTAP_SUPPORT=y
CONFIG_ESP_WIFI_STATIC_RX_BUFFER_NUM=10
CONFIG_ESP_WIFI_DYNAMIC_RX_BUFFER_NUM=32
CONFIG_ESP_WIFI_TX_BUFFER_TYPE=0
CONFIG_ESP_WIFI_STATIC_TX_BUFFER_NUM=16

# --- SD Card (SDMMC or SPI) ---
# CONFIG_SDMMC_HOST_ENABLED=y

# --- NVS ---
CONFIG_NVS_ENCRYPTION=n

# --- Logging ---
CONFIG_LOG_DEFAULT_LEVEL_INFO=y
CONFIG_LOG_MAXIMUM_LEVEL_DEBUG=y

# --- FreeRTOS ---
CONFIG_FREERTOS_TIMER_TASK_STACK_DEPTH=3072
CONFIG_FREERTOS_IDLE_TASK_STACKSIZE=2048

# --- Watchdog ---
CONFIG_ESP_TASK_WDT_EN=y
CONFIG_ESP_TASK_WDT_TIMEOUT_S=10
```

## CAN_Interface/sdkconfig.defaults
```kconfig
# CAN_ESPIDF CAN Interface Node - SDK Configuration Defaults
# Target: ESP32-S3 (N16R8)

# --- CPU & Memory ---
CONFIG_ESP_DEFAULT_CPU_FREQ_MHZ_240=y
CONFIG_FREERTOS_HZ=1000
CONFIG_FREERTOS_UNICORE=n
CONFIG_ESP_SYSTEM_EVENT_TASK_STACK_SIZE=4096

# --- Flash & Partitions ---
# N16R8: 16MB flash (verify with device_test)
CONFIG_ESPTOOLPY_FLASHSIZE_16MB=y
CONFIG_PARTITION_TABLE_CUSTOM=y
CONFIG_PARTITION_TABLE_CUSTOM_FILENAME="partitions.csv"

# --- PSRAM ---
CONFIG_SPIRAM=y
CONFIG_SPIRAM_MODE_OCT=y

# --- TWAI (CAN) - reserved for 1-Wire GM legacy ---
CONFIG_TWAI_ISR_IN_IRAM=y

# --- SPI (for Waveshare 2-CH CAN FD HAT / MCP2518FD) ---
CONFIG_SPI_MASTER_IN_IRAM=y

# --- NVS ---
CONFIG_NVS_ENCRYPTION=n

# --- Logging ---
CONFIG_LOG_DEFAULT_LEVEL_INFO=y
CONFIG_LOG_MAXIMUM_LEVEL_DEBUG=y

# --- FreeRTOS ---
CONFIG_FREERTOS_TIMER_TASK_STACK_DEPTH=3072
CONFIG_FREERTOS_IDLE_TASK_STACKSIZE=2048

# --- Watchdog ---
CONFIG_ESP_TASK_WDT_EN=y
CONFIG_ESP_TASK_WDT_TIMEOUT_S=10
```
